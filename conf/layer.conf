## conf/layer.conf
```bitbake
# We have a conf and classes directory, add to BBPATH
BBPATH .= ":${LAYERDIR}"

LAYERSERIES_COMPAT_swupdate-nina = "dunfell gatesgarth hardknott"

LAYERDEPENDS_swupdate-nina = "openembedded-layer"
```
